#include "Font.h"

struct Glyph {
  uint32_t cp;
  uint16_t cols[6];
};

static const Glyph GLYPHS_PUNCT[] PROGMEM = {
  {0x20, {0x000,0x000,0x000,0x000,0x000,0x000}}, // space
  {0x2E, {0x000,0x000,0x100,0x000,0x000,0x000}}, // .
  {0x2C, {0x000,0x200,0x100,0x000,0x000,0x000}}, // ,
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  {0x29, {0x000,0x000,0x104,0x0F8,0x000,0x000}}, // )
};

static const Glyph GLYPHS_DIGITS[] PROGMEM = {
  {0x30, {0x0F8,0x144,0x124,0x114,0x0F8,0x000}}, // 0
  {0x31, {0x110,0x108,0x1FC,0x100,0x100,0x000}}, // 1
  {0x32, {0x108,0x184,0x144,0x124,0x118,0x000}}, // 2
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  {0x39, {0x098,0x124,0x124,0x124,0x0F8,0x000}}, // 9
};

// A-Z
static const Glyph GLYPHS_LATIN[] PROGMEM = {
  {0x41, {0x1F8,0x024,0x024,0x024,0x1F8,0x000}}, // A
  {0x42, {0x1FC,0x124,0x124,0x124,0x0D8,0x000}}, // B
  {0x43, {0x0F8,0x104,0x104,0x104,0x088,0x000}}, // C
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  {0x5A, {0x184,0x144,0x124,0x114,0x10C,0x000}}, // Z
};

// А-Я
static const Glyph GLYPHS_CYR[] PROGMEM = {
  {0x401, {0x1FC,0x125,0x124,0x125,0x104,0x000}}, // Ё
  {0x410, {0x1F8,0x024,0x024,0x024,0x1F8,0x000}}, // А
  {0x411, {0x1FC,0x124,0x124,0x124,0x0C4,0x000}}, // Б
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  {0x42F, {0x118,0x0A4,0x064,0x024,0x1FC,0x000}}, // Я
};

uint32_t Font::normalize(uint32_t cp) {
  if (cp >= (uint32_t)'a' && cp <= (uint32_t)'z') {
    return cp - 32;
  }

  if (cp >= 0x430 && cp <= 0x44F) {
    return cp - 0x20;
  }
  if (cp == 0x451) {
    return 0x401;
  }

  return cp;
}

static bool readGlyphFromTable(const Glyph* table, size_t count, uint32_t cp, uint16_t outCols[Font::W]) {
  for (size_t i = 0; i < count; i++) {
    Glyph g;
    memcpy_P(&g, &table[i], sizeof(Glyph));

    if (g.cp == cp) {
      memcpy(outCols, g.cols, sizeof(g.cols));
      return true;
    }
  }
  return false;
}

bool Font::getGlyph(uint32_t codepoint, uint16_t outCols[Font::W]) {
  uint32_t cp = normalize(codepoint);

  if (readGlyphFromTable(GLYPHS_PUNCT,  sizeof(GLYPHS_PUNCT)  / sizeof(Glyph), cp, outCols)) return true;
  if (readGlyphFromTable(GLYPHS_DIGITS, sizeof(GLYPHS_DIGITS) / sizeof(Glyph), cp, outCols)) return true;
  if (readGlyphFromTable(GLYPHS_LATIN,  sizeof(GLYPHS_LATIN)  / sizeof(Glyph), cp, outCols)) return true;
  if (readGlyphFromTable(GLYPHS_CYR,    sizeof(GLYPHS_CYR)    / sizeof(Glyph), cp, outCols)) return true;

  static const uint16_t q[Font::W] = {0x002, 0x001, 0x059, 0x006, 0x000, 0x000};
  memcpy(outCols, q, sizeof(q));
  return false;
}
